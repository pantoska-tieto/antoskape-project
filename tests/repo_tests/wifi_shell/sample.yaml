## tests/repo_tests/wifi_shell/sample.yaml
```yaml
common:
  harness: net
  tags:
    - net
    - wifi
sample:
  description: Test wifi driver and APIs functionality
  name: WiFi sample app
tests:
  repo_tests.wifi_shell:
    harness: pytest
    harness_config:
      pytest_dut_scope: session
    platform_allow:
      - esp32s3_devkitc/esp32s3/procpu
      - esp8684_devkitm
    integration_platforms:
      - esp32s3_devkitc/esp32s3/procpu
      - esp32c3_devkitm
    tags:
      - wifi
      - integration
```

## tests/repo_tests/zperf/sample.yaml
```yaml
common:
  tags:
    - net
    - zperf
  platform_exclude:
    - sam_e70_xplained/same70q21
  min_ram: 64
sample:
  description: Network performance measurement tool for Zephyr
  name: zperf
tests:
  sample.net.zperf:
    harness: pytest
    harness_config:
      pytest_dut_scope: module
    platform_allow: 
      - qemu_x86
      - esp32s3_devkitc/esp32s3/procpu
      - esp32c3_devkitm
    integration_platforms:
      - esp32s3_devkitc/esp32s3/procpu
      - esp32c3_devkitm
    tags:
      - zperf
      - wifi
      - integration
```

## tests/unit_tests/dut/gpio_pins_pytest/testcase.yaml
```yaml
tests:
  unit_tests.dut.gpio_pins_pytest:
    tags: gpio
    platform_allow:
      - esp32s3_devkitc/esp32s3/procpu
      - esp32c3_devkitm
    harness: pytest

  unit_tests.dut.gpio_pins_pytest.native_sim:
    tags: gpio
    platform_allow:
      - native_sim/native/64
      - native_sim
    harness: shell
    harness_config:
      pytest_dut_scope: session
      shell_commands:
        - command: "gpio devices"
          expected: ".*"
        - command: "gpio conf gpio0 13 ouh"
          expected: ".*"
        - command: "gpio get gpio0 9"
          expected: ".*1.*"
        - command: "gpio conf gpio0 13 oul"
          expected: ".*"
        - command: "gpio get gpio0 9"
          expected: ".*0.*"
```

## tests/unit_tests/dut/gpio_pins_ztest/testcase.yaml
```yaml
tests:
  unit_tests.dut.gpio_pins:
    tags:
    - drivers
    - gpio
    depends_on: gpio
    harness: ztest
    platform_allow:
      - esp32s3_devkitc/esp32s3/procpu
      - esp32c3_devkitm
    
```

## tests/unit_tests/dut/gpio_toggle_ztest/testcase.yaml
```yaml
tests:
  sample.ztest.gpio:
    platform_allow: esp32s3_devkitc/esp32s3/procpu
    tags:
      - gpio
      - integration
    harness: ztest
    integration_platforms:
      - esp32s3_devkitc/esp32s3/procpu
      - esp32c3_devkitm
```
