## CMakeLists.txt
```
# SPDX-License-Identifier: Apache-2.0

cmake_minimum_required(VERSION 3.20.0)
# pantosk - path to custom overlay file 
set(DTC_OVERLAY_FILE "boards/esp32s3_devkitc.overlay")

find_package(Zephyr REQUIRED HINTS $ENV{ZEPHYR_BASE})
project(blinky)

target_sources(app PRIVATE src/main.c)
```

## prj.conf
```kconfig
CONFIG_LOG=y
CONFIG_PWM=y
CONFIG_PWM_LOG_LEVEL_DBG=y
```

## src/main.c
```c
#include <zephyr/kernel.h>
#include <zephyr/device.h>
#include <zephyr/drivers/pwm.h>
#include <zephyr/logging/log.h>
#include <zephyr/sys/printk.h>


#define PWM_CTLR_NODE DT_ALIAS(pwm_led0)

#if !DT_NODE_HAS_STATUS(PWM_CTLR_NODE, okay)
#error "Unsupported board: pwmled0 devicetree alias is not defined"
#endif

static const struct pwm_dt_spec pwm_led = PWM_DT_SPEC_GET(PWM_CTLR_NODE);

int main(void)
{
    // Set duty cycle PWM signal
    uint32_t period = 5000U;     // 5000 microseconds = 200Hz
    uint32_t pulse_width = 500U; // 500 microseconds => duty cycle = 10%

    if (!device_is_ready(pwm_led.dev)) {
        printk("PWM device is not ready");
        return 0;
    }

    // Start transmitting PWM signal
    printk("Starting PWM on target device...\n");
    int ret = pwm_set_dt(&pwm_led, PWM_USEC(period), PWM_USEC(pulse_width));
    if (ret) {
        printk("Failed to set PWM: %d", ret);
    } else {
        printk("PWM set: period = %u us, pulse = %u us", period, pulse_width);
    }

    // Time delay to stabilize PWM signal
    k_sleep(K_SECONDS(5)); 
}
```
