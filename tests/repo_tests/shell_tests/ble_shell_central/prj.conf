## prj.conf
```kconfig
CONFIG_BT=y
CONFIG_BT_CENTRAL=y

# Enable shell
CONFIG_SHELL=y

# Enable shell over UART
CONFIG_UART_CONSOLE=y
CONFIG_SHELL_BACKEND_SERIAL=y

# Enable console output
CONFIG_CONSOLE=y
CONFIG_PRINTK=y

# Optional: enable command history and autocompletion
CONFIG_SHELL_HISTORY=y
CONFIG_SHELL_CMDS=y
CONFIG_SHELL_HELP=y

# Enable logging to console
CONFIG_LOG=y
CONFIG_LOG_MODE_IMMEDIATE=y
CONFIG_LOG_BACKEND_UART=y
CONFIG_LOG_MAX_LEVEL=3
CONFIG_BT_RX_STACK_SIZE=2048
CONFIG_BT_HCI_TX_STACK_SIZE=1024
```

## src/main.c
```c
/* main.c - Application main entry point */

/*
 * Copyright (c) 2015-2016 Intel Corporation
 *
 * SPDX-License-Identifier: Apache-2.0
 */

#include <zephyr/types.h>
#include <stddef.h>
#include <errno.h>
#include <zephyr/kernel.h>
#include <zephyr/sys/printk.h>

#include <zephyr/bluetooth/bluetooth.h>
#include <zephyr/bluetooth/hci.h>
#include <zephyr/bluetooth/conn.h>
#include <zephyr/bluetooth/uuid.h>
#include <zephyr/bluetooth/gatt.h>
#include <zephyr/sys/byteorder.h>


static void start_scan(void);

static struct bt_conn *default_conn;

static char name_buf[30]; // Buffer for device name

static bool ad_parse_cb(struct bt_data *data, void *user_data)
{
    if (data->type == BT_DATA_NAME_COMPLETE || data->type == BT_DATA_NAME_SHORTENED) {
        size_t len = MIN(data->data_len, sizeof(name_buf) - 1);
        memcpy(name_buf, data->data, len);
        name_buf[len] = '\0';
    }
    return true;
}

static void device_found(const bt_addr_le_t *addr, int8_t rssi, uint8_t type,
                         struct net_buf_simple *ad)
{
    char addr_str[BT_ADDR_LE_STR_LEN];
    int err;

    bt_addr_le_to_str(addr, addr_str, sizeof(addr_str));

    // Skip weak signals early
    if (rssi < -60) {
        printk("Skipping %s due to weak RSSI (%d)\n", addr_str, rssi);
        return;
    }

    // Only connectable advertisements
    if (type != BT_GAP_ADV_TYPE_ADV_IND &&
        type != BT_GAP_ADV_TYPE_ADV_DIRECT_IND) {
        printk("Ignoring %s: not connectable (type %u)\n", addr_str, type);
        return;
    }

    // Parse advertising name
    name_buf[0] = '\0';
    bt_data_parse(ad, ad_parse_cb, NULL);

    if (name_buf[0]) {
        printk("Device found: %s (RSSI %d), Name: %s\n", addr_str, rssi, name_buf);
    } else {
        printk("Device found: %s (RSSI %d), Name: <unknown>\n", addr_str, rssi);
    }

    if (default_conn) {
        return;
    }

    if (bt_le_scan_stop()) {
        return;
    }

    err = bt_conn_le_create(addr, BT_CONN_LE_CREATE_CONN,
                            BT_LE_CONN_PARAM_DEFAULT, &default_conn);
    if (err) {
        printk("Create conn to %s failed (%d)\n", addr_str, err);
        start_scan();
    }
}

static void start_scan(void)
{
	int err;

	/* This demo doesn't require active scan */
	err = bt_le_scan_start(BT_LE_SCAN_PASSIVE, device_found);
	if (err) {
		printk("Scanning failed to start (err %d)\n", err);
		return;
	}

	printk("Scanning successfully started\n");
}

static void connected(struct bt_conn *conn, uint8_t err)
{
	char addr[BT_ADDR_LE_STR_LEN];

	bt_addr_le_to_str(bt_conn_get_dst(conn), addr, sizeof(addr));

	if (err) {
		printk("Failed to connect to %s %u %s\n", addr, err, bt_hci_err_to_str(err));

		bt_conn_unref(default_conn);
		default_conn = NULL;

		start_scan();
		return;
	}

	if (conn != default_conn) {
		return;
	}

	printk("Connected: %s\n", addr);

	bt_conn_disconnect(conn, BT_HCI_ERR_REMOTE_USER_TERM_CONN);
}

static void disconnected(struct bt_conn *conn, uint8_t reason)
{
	char addr[BT_ADDR_LE_STR_LEN];

	if (conn != default_conn) {
		return;
	}

	bt_addr_le_to_str(bt_conn_get_dst(conn), addr, sizeof(addr));

	printk("Disconnected: %s, reason 0x%02x %s\n", addr, reason, bt_hci_err_to_str(reason));

	bt_conn_unref(default_conn);
	default_conn = NULL;

	start_scan();
}

BT_CONN_CB_DEFINE(conn_callbacks) = {
	.connected = connected,
	.disconnected = disconnected,
};

int main(void)
{
	int err;

	err = bt_enable(NULL);
	if (err) {
		printk("Bluetooth init failed (err %d)\n", err);
		return 0;
	}

	printk("Bluetooth initialized\n");
	// Time delay to get all uart prompt lines available in pytest
	k_sleep(K_SECONDS(2));
	start_scan();
	return 0;
}
```
