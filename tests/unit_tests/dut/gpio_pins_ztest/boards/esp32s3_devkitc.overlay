/ {
     aliases {
             led9 = &myled9;
     };

     leds {
             compatible = "gpio-leds";
             myled9: led_9 {
                     gpios = <&gpio0 9 GPIO_ACTIVE_LOW>;
             };
     };
};