## prj.conf
```kconfig
CONFIG_PRINTK=y
CONFIG_SHELL=y
CONFIG_LOG=y
CONFIG_SHELL_BACKEND_SERIAL=y
CONFIG_SERIAL=y
CONFIG_UART_ESP32=y
# Ensure shell prompt is enabled and visible
CONFIG_SHELL_PROMPT_UART="0. :uart:~$ "

# Enable input/output for UART shell
CONFIG_SHELL_BACKEND_SERIAL_INTERRUPT_DRIVEN=y

# Optional: Increase shell stack size for stability
CONFIG_SHELL_STACK_SIZE=4096

# Optional: Enable history and echo for better interaction
CONFIG_SHELL_HISTORY=y
CONFIG_SHELL_CMDS=y
CONFIG_UART_CONSOLE=y
```

## src/main.c
```c
/*
 * Copyright (c) 2023 Nordic Semiconductor ASA
 *
 * SPDX-License-Identifier: Apache-2.0
 */

 #include <shell/shell.h>
 
int main(void)
{
	/* Shell application source code is injected by applied Kconfg SHELL
	 * options, no more "extra" functionalities are required for exemplary
	 * pytest test.
	 */
	return 0;
}
```
