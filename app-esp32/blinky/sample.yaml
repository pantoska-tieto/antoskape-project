## app-esp32/blinky/sample.yaml
```yaml
sample:
  name: Blinky Sample
tests:
  sample.basic.blinky:
    platform_allow: esp32s3_devkitc/esp32s3/procpu
    tags:
      - LED
      - gpio
    filter: dt_enabled_alias_with_parent_compat("led0", "gpio-leds")
    depends_on: gpio
    harness: led
    integration_platforms:
      - native_sim/native/64
      - esp32s3_devkitc/esp32s3/procpu
      - esp32c3_devkitm
```

## test/basic/testcase.yaml
```yaml
tests:
  sample.pytest.basic:
    min_ram: 40
    harness: pytest
    integration_platforms:
      - native_sim
      - esp32s3_devkitc/esp32s3/procpu
    tags:
      - pytest
```

## test/mcumgr/testcase.yaml
```yaml
common:
  sysbuild: true
  platform_allow:
    - esp32s3_devkitc/esp32s3/procpu
  timeout: 600
  slow: true
  tags:
    - pytest
    - mcuboot
    - mcumgr
tests:
  boot.with_mcumgr.test_upgrade:
    platform_allow:
      - esp32s3_devkitc/esp32s3/procpu
    integration_platforms:
      - esp32s3_devkitc/esp32s3/procpu
    harness: pytest
    harness_config:
      pytest_root:
        - "pytest/test_shell.py"
```

## test/repo_tests/wifi-shell/sample.yaml
```yaml
common:
  tags:
    - net
    - wifi
sample:
  description: Test wifi driver and APIs functionality
  name: WiFi sample app
tests:
  sample.net.wifi.esp32:
    harness: pytest
    extra_args:
      - CONFIG_BUILD_ONLY_NO_BLOBS=y
    platform_allow:
      - esp32s3_devkitc/esp32s3/procpu
      - esp32_devkitc/esp32/procpu
      - esp32s2_saola
      - esp32c3_devkitm
      - esp32s3_devkitm/esp32s3/procpu
      - esp8684_devkitm
      - esp32c6_devkitc/esp32c6/hpcore
```

## test/shell/testcase.yaml
```yaml
common:
  tags:
    - test_framework
    - pytest
    - shell
  platform_exclude: qemu_rx
  min_ram: 40
  integration_platforms:
    - native_sim/native/64
    - qemu_cortex_m3
    - esp32s3_devkitc/esp32s3/procpu
tests:
  sample.pytest.shell:
    harness: pytest
    timeout: 300   # Timeout in seconds
  sample.pytest.shell.vt100_colors_off:
    harness: pytest
    extra_configs:
      - CONFIG_SHELL_VT100_COLORS=n
  sample.harness.shell:
    harness: shell
    timeout: 300   # Timeout in seconds
    harness_config:
      shell_commands: &kernel_commands
        - command: "kernel cycles"
          expected: "cycles: .* hw cycles"
        - command: "kernel version"
          expected: "Zephyr version .*"
        - command: "kernel sleep 100"
  sample.harness.shell.vt100_colors_off:
    harness: shell
    extra_configs:
      - CONFIG_SHELL_VT100_COLORS=n
    harness_config:
      shell_commands: *kernel_commands
```

## tests/integration_tests/basic/testcase.yaml
```yaml
tests:
  sample.pytest.basic:
    min_ram: 40
    harness: pytest
    tags:
      - pytest
```

## tests/manual_tests/esp32_toggle_led_qemu/sample.yaml
```yaml
sample:
  name: Espressif QEMU test
tests:
  sample.basic.blinky:
    platform_allow:
      - qemu
    tags:
      - LED
      - gpio
    filter: dt_enabled_alias_with_parent_compat("led0", "gpio-leds")
    depends_on: gpio
    harness: led
```

## tests/repo_tests/bt_peripheral/sample.yaml
```yaml
sample:
  name: Bluetooth Peripheral
  description: Demonstrates the Bluetooth LE Peripheral role
tests:
  sample.bluetooth.peripheral:
    harness: pytest
    platform_allow:
      - qemu_x86
      - nucleo_wb55rg
      - esp32s3_devkitc/esp32s3/procpu
      - esp32c3_devkitm
    integration_platforms:
      - qemu_x86
      - esp32s3_devkitc/esp32s3/procpu
    tags: bluetooth
```

## tests/repo_tests/bt_peripheral/testcase.yaml
```yaml
tests:
  sample.bluetooth.peripheral:
    platform_allow:
      - qemu_x86
      - nucleo_wb55rg
      - esp32s3_devkitc/esp32s3/procpu
      - esp32c3_devkitm
    integration_platforms:
      - qemu_x86
      - esp32s3_devkitc/esp32s3/procpu
      - esp32c3_devkitm
    harness: pytest
    timeout: 180
    tags: 
      - bluetooth
      - integration
```

## tests/repo_tests/general_tests/dfu_ota_bluetooth/testcase.yaml
```yaml
tests:
  repo_tests.mcumgr.ota.bt:
    harness: pytest
    sysbuild: true
    tags:
      - bluetooth
      - dfu
      - ota
    timeout: 280
    extra_args: 
      - EXTRA_CONF_FILE="overlay-bt.conf"
      - -DEXTRA_CONF_FILE="overlay-bt.conf"
    platform_allow:
      - esp32s3_devkitc/esp32s3/procpu
      - esp32c3_devkitm
    integration_platforms:
      - esp32s3_devkitc/esp32s3/procpu
      - esp32c3_devkitm
```

## tests/repo_tests/general_tests/mock_adc/sample.yaml
```yaml
tests:
  repo_tests.adc.mocking:
    tags: adc
    platform_allow:
      - native_sim/native/64
    harness: console    
    harness_config:
      type: one_line
      regex: 
        - "ADC read value: 1234"
```

## tests/repo_tests/general_tests/power_cycle_boot/testcase.yaml
```yaml
tests:
  repo_tests.power_cycle.booting:
    tags: booting
    platform_allow:
      - esp32s3_devkitc/esp32s3/procpu
      - esp32c3_devkitm
    harness: pytest
    timeout: 100
```

## tests/repo_tests/general_tests/pwm_ledc/testcase.yaml
```yaml
tests:
  repo_tests.pwm.ledc:
    platform_allow:
      - esp32s3_devkitc/esp32s3/procpu
      - esp32c3_devkitm
    tags:
      - LED
      - gpio
    depends_on: gpio
    harness: pytest
    integration_platforms:
      - esp32s3_devkitc/esp32s3/procpu
      - esp32c3_devkitm
```

## tests/repo_tests/gpio_toggle_pytest/testcase.yaml
```yaml
tests:
  repo_tests.gpio_toggle_pytest:
    tags: gpio
    platform_allow:
      - esp32s3_devkitc/esp32s3/procpu
      - esp32c3_devkitm
    harness: pytest
```

## tests/repo_tests/gpio_toggle_ztest/testcase.yaml
```yaml
tests:
  repo_tests.dut.gpio_toggle_ztest:
    platform_allow:
      - esp32s3_devkitc/esp32s3/procpu
      - esp32c3_devkitm
    tags:
      - gpio
      - integration
      - ztest
    harness: ztest
    integration_platforms:
      - esp32s3_devkitc/esp32s3/procpu
      - esp32c3_devkitm
```

## tests/repo_tests/shell_tests/ble_shell_basics_battery/ble_shell_basics_battery/ble_shell_basics_battery/testcase.yaml
```yaml
tests:
  bluetooth.shell.battery-level:
    platform_allow:
      - qemu_x86
      - native_sim
      - nrf52840dk/nrf52840
      - esp32s3_devkitc/esp32s3/procpu
    integration_platforms:
      - qemu_x86
      - esp32s3_devkitc/esp32s3/procpu
    tags:
      - bluetooth
      - shell
      - battery
    harness: pytest
```

## tests/repo_tests/shell_tests/ble_shell_basics_battery/testcase.yaml
```yaml
tests:
  bluetooth.shell.battery_level:
    platform_allow:
      - esp32s3_devkitc/esp32s3/procpu
      - esp32c3_devkitm
    integration_platforms:
      - esp32s3_devkitc/esp32s3/procpu
      - esp32c3_devkitm
    tags:
      - bluetooth
      - shell
      - battery
    harness: pytest
```

## tests/repo_tests/shell_tests/ble_shell_central/testcase.yaml
```yaml
tests:
  bluetooth.central.console:
    platform_allow:
      - esp32s3_devkitc/esp32s3/procpu
      - esp32c3_devkitm
    harness: console
    harness_config:
      type: one_line
      regex:
        - ".*Device found: .* Name: PA-iPhone.*"
  bluetooth.central.hardware:
    harness: pytest
    extra_args:
      - CONFIG_BUILD_ONLY_NO_BLOBS=n
    platform_allow:
      - esp32s3_devkitc/esp32s3/procpu
      - esp32c3_devkitm
```

## tests/repo_tests/shell_tests/ble_shell_hrs_bas/testcase.yaml
```yaml
tests:
  bluetooth.shell.hrs.bas:
    platform_allow:
      - qemu_x86
      - native_sim
      - nrf52840dk/nrf52840
      - esp32s3_devkitc/esp32s3/procpu
    integration_platforms:
      - qemu_x86
      - esp32s3_devkitc/esp32s3/procpu
    tags:
      - bluetooth
      - shell
      - battery
      - hrs
    harness: pytest
```

## tests/repo_tests/shell_tests/ble_shell_hrs_mocked/testcase.yaml
```yaml
tests:
  bluetooth.shell.hrs.mocked:
    platform_allow:
      - esp32s3_devkitc/esp32s3/procpu
      - esp32c3_devkitm
    integration_platforms:
      - esp32s3_devkitc/esp32s3/procpu
      - esp32c3_devkitm
    tags:
      - bluetooth
      - shell
      - hrs
    harness: pytest
```

## tests/repo_tests/shell_tests/boot_shell/testcase.yaml
```yaml
common:
  tags:
    - test_framework
    - pytest
    - shell
  platform_exclude: qemu_rx
  filter: CONFIG_SERIAL and not CONFIG_SMP and dt_chosen_enabled("zephyr,shell-uart")
  extra_configs:
    - arch:posix:CONFIG_UART_NATIVE_PTY_0_ON_STDINOUT=y
  min_ram: 40
  integration_platforms:
    - native_sim
    - qemu_cortex_m3
    - esp32s3_devkitc/esp32s3/procpu
    - esp32c3_devkitm
tests:
  repo_tests.shell.pytest.shell:
    harness: pytest
    harness_config:
      pytest_dut_scope: session
    tags: antoska
  repo_tests.shell.pytest.shell.vt100_colors_off:
    harness: pytest
    extra_configs:
      - CONFIG_SHELL_VT100_COLORS=n
    harness_config:
      pytest_dut_scope: session
  repo_tests.shell.harness.shell:
    harness: shell
    harness_config:
      pytest_dut_scope: session
      shell_commands: &kernel_commands
        - command: "kernel cycles"
          expected: "cycles: .* hw cycles"
        - command: "kernel version"
          expected: "Zephyr version .*"
        - command: "kernel sleep 100"
  repo_tests.shell.harness.shell.vt100_colors_off:
    harness: shell
    extra_configs:
      - CONFIG_SHELL_VT100_COLORS=n
    harness_config:
      shell_commands: *kernel_commands
      pytest_dut_scope: session
```

## tests/repo_tests/shell_tests/display_shell_framebuffer/testcase.yaml
```yaml
tests:
  display.shell.framebuffer:
    platform_allow:
      - esp32s3_devkitc/esp32s3/procpu
      - esp32c3_devkitm
    integration_platforms:
      - esp32s3_devkitc/esp32s3/procpu
      - esp32c3_devkitm
    tags:
      - display
      - shell
    harness: pytest

  display.shell.framebuffer.native_sim:
    tags:
      - display
      - shell
    platform_allow:
      - native_sim/native/64
      - native_sim
    harness: shell
    harness_config:
      pytest_dut_scope: session
      shell_commands:
        - command: "display_status"
          expected: ".*Framebuffer CRC32: 0xfdc935d3.*"
```

## tests/repo_tests/shell_tests/i2c_shell_mocked/testcase.yaml
```yaml
tests:
  sensor.shell.i2c.read.console:
    tags:
      - sensor
      - i2c
    platform_allow:
      - native_sim
      - native_sim/native/64
    harness: console
    harness_config:
      type: one_line
      regex:
        - ".*write to address: 0x68 with value: 0x55.*"
        - ".*read from address: 0x68 with value: 0x55.*"
        - ".*write to address: 0x69 with value: 0x56.*"
        - ".*read from address: 0x69 with value: 0x56.*"
  sensor.shell.i2c.read:
    tags:
      - sensor
      - i2c
    platform_allow:
      - native_sim
      - native_sim/native/64
    harness: pytest
```

## tests/repo_tests/shell_tests/sensor_shell_proximity/testcase.yaml
```yaml
tests:
  sensor.shell.proximity:
    platform_allow:
      - esp32s3_devkitc/esp32s3/procpu
      - esp32c3_devkitm
    integration_platforms:
      - esp32s3_devkitc/esp32s3/procpu
      - esp32c3_devkitm
    tags:
      - sensor
      - proximity
      - shell
    harness: pytest
```

## tests/repo_tests/shell_tests/spi_shell_mocked/testcase.yaml
```yaml
tests:
  sensor.shell.spi.read.console:
    tags:
      - sensor
      - spi
    platform_allow:
      - native_sim
      - native_sim/native/64
    harness: console
    harness_config:
      type: multi_line
      regex:
        - ".*Reading 6 registers starting from 0x12:*"
        - ".*0x12: 0x34.*"
        - ".*0x13: 0x12.*"
        - ".*0x14: 0x78.*"
        - ".*0x15: 0x56.*"
        - ".*0x16: 0xBC.*"
        - ".*0x17: 0x9A.*"
  sensor.shell.spi.read:
    tags:
      - sensor
      - spi
    platform_allow:
      - native_sim
      - native_sim/native/64
    harness: pytest
```
